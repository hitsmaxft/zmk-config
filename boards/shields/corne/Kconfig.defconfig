## boards/shields/corne/Kconfig.defconfig
```kconfig
## main device and usb end point
if SHIELD_CORNE_LEFT || SHIELD_CORNE_DONGLE

config ZMK_KEYBOARD_NAME
	default "Corne"

config ZMK_USB
	default y 

config ZMK_SPLIT_ROLE_CENTRAL
    default y

config ZMK_SPLIT_BLE_ROLE_CENTRAL
	default y

config  ZMK_SPLIT_BLE_CENTRAL_BATTERY_LEVEL_FETCHING
	default y

config ZMK_SPLIT_BLE_CENTRAL_BATTERY_LEVEL_PROXY
	default y

endif # END DONGLE

## sub device
if SHIELD_CORNE_PH_LEFT || SHIELD_CORNE_RIGHT

# disable oled display
config SSD1306
    default n

config ZMK_SPLIT_ROLE_CENTRAL
    default n

config ZMK_SPLIT_BLE_ROLE_CENTRAL
	default n

config ZMK_USB
    default n

# 增加键盘消抖
config ZMK_KSCAN_DEBOUNCE_PRESS_MS
    default 5
config ZMK_KSCAN_DEBOUNCE_RELEASE_MS
    default 5


endif # END peripherals



# common option 
if SHIELD_CORNE_DONGLE || SHIELD_CORNE_LEFT || SHIELD_CORNE_PH_LEFT || SHIELD_CORNE_RIGHT

config ZMK_SPLIT
	default y


if ZMK_DISPLAY

config I2C
    default y

endif # ZMK_DISPLAY

if LVGL

config LV_Z_VDB_SIZE
    default 64

config LV_DPI_DEF
    default 148

config LV_Z_BITS_PER_PIXEL
    default 1

choice LV_COLOR_DEPTH
    default LV_COLOR_DEPTH_1
endchoice

endif # LVGL

endif # END ALL
```

## boards/shields/corne/Kconfig.shield
```kconfig
# Copyright (c) 2020 Pete Johanson
# SPDX-License-Identifier: MIT

config SHIELD_CORNE_DONGLE
	def_bool $(shields_list_contains,corne_dongle)

	
config SHIELD_CORNE_LEFT
	def_bool $(shields_list_contains,corne_left)


config SHIELD_CORNE_PH_LEFT
	def_bool $(shields_list_contains,corne_ph_left)
config SHIELD_CORNE_right
	def_bool $(shields_list_contains,corne_right)
```

## config/boards/shields/corne/Kconfig.defconfig
```kconfig
if SHIELD_CORNE_DONGLE

# Set this to the number of peripherals your dongle will have.
# For a unibody, this would be 1. If you have left and right halves, set it to 2, etc.
config ZMK_SPLIT_BLE_CENTRAL_PERIPHERALS
    default 2

config ZMK_KEYBOARD_NAME
	default "Corne"

config ZMK_SPLIT_BLE_ROLE_CENTRAL
	default y

# Set this to ZMK_SPLIT_BLE_CENTRAL_PERIPHERALS + your desired number of BT profiles (default is 5)
config BT_MAX_CONN
    default 6

# Set this to the same number as BT_MAX_CONN
config BT_MAX_PAIRED
    default 6

endif

#if SHIELD_CORNE_LEFT
# 
# config ZMK_KEYBOARD_NAME
# 	default "Corne"
# 
# config ZMK_SPLIT_BLE_ROLE_CENTRAL
# 	default y
# 
# endif


if SHIELD_CORNE_LEFT || SHIELD_CORNE_RIGHT || SHIELD_CORNE_DONGLE

config ZMK_SPLIT
    default y

if ZMK_DISPLAY

config I2C
    default y

config SSD1306
    default y

endif # ZMK_DISPLAY

if LVGL

config LV_Z_VDB_SIZE
    default 64

config LV_DPI_DEF
    default 148

config LV_Z_BITS_PER_PIXEL
    default 1

choice LV_COLOR_DEPTH
    default LV_COLOR_DEPTH_1
endchoice

endif # LVGL

endif
```

## config/west.yml
```yaml
manifest:
  remotes:
    - name: zmkfirmware
      url-base: https://github.com/zmkfirmware
    - name: hitsmaxft
      url-base: https://github.com/hitsmaxft
    - name: local
      url-base: file://.
  projects:
    - name: zmk
      remote: zmkfirmware
      revision: main
      clone-depth: 1
      import:
        path-prefix: zmk_exts
        file: app/west.yml
  self:
    path: config
    import:
      file: deps.yml
      path-prefix: zmk_exts
```
